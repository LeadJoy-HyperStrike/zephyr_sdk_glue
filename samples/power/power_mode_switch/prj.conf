## CMakeLists.txt
```
# Copyright (c) 2026 HPMicro
# SPDX-License-Identifier: Apache-2.0

cmake_minimum_required(VERSION 3.20.0)
find_package(Zephyr REQUIRED HINTS $ENV{ZEPHYR_BASE})
project(power_mode_switch)

target_sources(app PRIVATE src/main.c src/hpm5100_lp.c)
```

## prj.conf
```kconfig
CONFIG_CONSOLE=y
CONFIG_UART_CONSOLE=y
CONFIG_CONSOLE_SUBSYS=y
CONFIG_CONSOLE_GETCHAR=y
CONFIG_PRINTK=y
CONFIG_MAIN_STACK_SIZE=2048
CONFIG_COUNTER=y
CONFIG_PM=y
CONFIG_PM_DEVICE=y
CONFIG_PM_DEVICE_SYSTEM_MANAGED=y
CONFIG_PM_NEED_ALL_DEVICES_IDLE=y
```

## src/main.c
```c
/*
 * Copyright (c) 2026 HPMicro
 * SPDX-License-Identifier: Apache-2.0
 *
 * Interactive power mode switch (HPM SDK power_mode_switch port).
 */

#include <zephyr/device.h>
#include <zephyr/devicetree.h>
#include <zephyr/drivers/uart.h>
#include <zephyr/kernel.h>
#include <zephyr/sys/printk.h>

#include "hpm_clock_drv.h"
#include "hpm5100_lp.h"

static void show_clocks(void)
{
	uint32_t cpu_hz = clock_get_frequency(clock_cpu0);
	uint32_t ahb_hz = clock_get_frequency(clock_ahb);

	printk("CPU %u Hz (%u MHz), AHB %u Hz (%u MHz)\r\n",
	       cpu_hz, cpu_hz / 1000000U, ahb_hz, ahb_hz / 1000000U);
}

static void show_menu(void)
{
	printk("\r\nPower mode switch demo:\r\n"
	       "  1 - Enter wait mode\r\n"
	       "  2 - Enter stop mode\r\n"
	       "  3 - Enter standby mode\r\n"
	       "  4 - Enter shutdown mode\r\n"
	       "  5 - Idle stop 3s (PTMR sysclock)\r\n\r\n");
}

int main(void)
{
	const struct device *console_dev = DEVICE_DT_GET(DT_CHOSEN(zephyr_console));

	if (!device_is_ready(console_dev)) {
		printk("console device not ready\r\n");
		return 0;
	}

	printk("Power mode switch starting\r\n");
	show_clocks();
	prepare_soc_low_power();
	show_menu();

	while (true) {
		unsigned char c;
		int ret = uart_poll_in(console_dev, &c);

		if (ret != 0) {
			k_yield();
			continue;
		}

		if ((c == 'w') || (c == '\r') || (c == '\n')) {
			continue;
		}

		switch (c) {
		case '1':
			if (enter_wait_mode() == 0) {
				printk("Woke up from the wait mode\r\n");
			}
			break;
		case '2':
			if (enter_stop_mode() == 0) {
				printk("Woke up from the stop mode\r\n");
			}
			break;
		case '3':
			enter_standby_mode();
			break;
		case '4':
			enter_shutdown_mode();
			break;
		case '5':
			if (enter_stop_timer_mode() == 0) {
				printk("Woke up from the stop mode\r\n");
			}
			break;
		default:
			printk("[!!] Please choose options listed above.\r\n");
			break;
		}

		show_menu();
	}

	return 0;
}
```

## src/hpm5100_lp.c
```c
/*
 * Copyright (c) 2026 HPMicro
 * SPDX-License-Identifier: Apache-2.0
 *
 * HPM5100EVK power-mode validation shell. SoC register programming and the
 * dedicated WKUP interrupt are owned by soc/hpmicro/HPM5100/power.c.
 */

#include <errno.h>
#include <soc.h>
#include <zephyr/device.h>
#include <zephyr/devicetree.h>
#include <zephyr/drivers/uart.h>
#include <zephyr/kernel.h>
#include <zephyr/pm/device.h>
#include <zephyr/pm/pm.h>
#include <zephyr/pm/policy.h>
#include <zephyr/pm/state.h>
#include <zephyr/sys/poweroff.h>
#include <zephyr/sys/printk.h>

#include "hpm5100_lp.h"

#define HPM_PM_STOP_SUBSTATE 1U
#define HPM_PM_WAIT_SUBSTATE 1U
#define HPM_STOP_TIMER_SLEEP_MS 3000

static volatile bool wait_wake_from_uart;
static volatile bool stop_wake_from_puart;
static K_SEM_DEFINE(pm_wake_sem, 0, 1);

static void pm_state_exit(enum pm_state state)
{
	if ((state == PM_STATE_RUNTIME_IDLE) ||
	    (state == PM_STATE_SUSPEND_TO_IDLE)) {
		k_sem_give(&pm_wake_sem);
	}
}

static struct pm_notifier pm_notifier = {
	.state_exit = pm_state_exit,
};

static void uart_wake_isr(const struct device *dev, void *user_data)
{
	volatile bool *woke = user_data;

	while (uart_irq_update(dev) && uart_irq_rx_ready(dev)) {
		uint8_t byte;

		(void)uart_fifo_read(dev, &byte, 1);
	}

	*woke = true;
}

static int arm_uart_wake(const struct device *dev, volatile bool *woke)
{
	uint8_t stale;
	int ret;

	if (!device_is_ready(dev)) {
		return -ENODEV;
	}

	while (uart_poll_in(dev, &stale) == 0) {
	}

	ret = uart_irq_callback_user_data_set(dev, uart_wake_isr,
					      (void *)woke);
	if (ret != 0) {
		return ret;
	}

	if (!pm_device_wakeup_enable(dev, true)) {
		(void)uart_irq_callback_user_data_set(dev, NULL, NULL);
		return -ENOTSUP;
	}

	*woke = false;
	uart_irq_rx_enable(dev);

	return 0;
}

static void disarm_uart_wake(const struct device *dev)
{
	if (!device_is_ready(dev)) {
		return;
	}

	uart_irq_rx_disable(dev);
	(void)uart_irq_callback_user_data_set(dev, NULL, NULL);
	(void)pm_device_wakeup_enable(dev, false);
}

static const struct pm_state_info *get_pm_state_info(enum pm_state state,
						     uint8_t substate_id)
{
	const struct pm_state_info *states;
	uint8_t count = pm_state_cpu_get_all(0, &states);

	for (uint8_t i = 0; i < count; i++) {
		if ((states[i].state == state) &&
		    (states[i].substate_id == substate_id)) {
			return &states[i];
		}
	}

	return NULL;
}

static int request_pm_state(enum pm_state state, uint8_t substate_id)
{
	const struct pm_state_info *info = get_pm_state_info(state, substate_id);

	if (info == NULL) {
		printk("PM state %u/%u not described by DTS\n", state, substate_id);
		return -EINVAL;
	}

	/*
	 * pm_state_force() bypasses pm_policy_next_state(), so retain the
	 * all-devices-idle guard used by the normal PM policy.
	 */
	if (pm_device_is_any_busy()) {
		printk("PM state %u/%u blocked by a busy device\n",
		       state, substate_id);
		return -EBUSY;
	}

	k_sem_reset(&pm_wake_sem);
	if (!pm_state_force(0U, info)) {
		printk("Failed to force PM state %u/%u\n", state, substate_id);
		return -EIO;
	}

	k_sem_take(&pm_wake_sem, K_FOREVER);

	return 0;
}

void prepare_soc_low_power(void)
{
	pm_notifier_register(&pm_notifier);
	/*
	 * This sample only enters low power via pm_state_force(). Lock idle
	 * Wait/Stop/soft-off so the menu loop cannot auto-Stop (JTAG all ones).
	 */
	pm_policy_state_lock_get(PM_STATE_RUNTIME_IDLE, PM_ALL_SUBSTATES);
	pm_policy_state_lock_get(PM_STATE_SUSPEND_TO_IDLE, PM_ALL_SUBSTATES);
	pm_policy_state_lock_get(PM_STATE_SOFT_OFF, PM_ALL_SUBSTATES);
}

int enter_wait_mode(void)
{
	const struct device *console =
		DEVICE_DT_GET(DT_CHOSEN(zephyr_console));
	int ret;

	ret = arm_uart_wake(console, &wait_wake_from_uart);
	if (ret != 0) {
		printk("Failed to arm console UART wake: %d\r\n", ret);
		return ret;
	}

	printk("Entering wait mode\r\n");
	printk("Press WKUP (PY07 / P1[8]) or send a byte to UART0 RX\r\n");

	ret = request_pm_state(PM_STATE_RUNTIME_IDLE, HPM_PM_WAIT_SUBSTATE);
	disarm_uart_wake(console);
	if (ret != 0) {
		return ret;
	}

	if (hpm_pm_wakeup_from_wkup_pin()) {
		printk("Wake source: WKUP pin (PY07)\r\n");
	} else if (wait_wake_from_uart) {
		printk("Wake source: UART RX\r\n");
	} else {
		printk("Wake source: unknown\r\n");
	}

	wait_wake_from_uart = false;

	return 0;
}

int enter_stop_mode(void)
{
	const struct device *puart = DEVICE_DT_GET(DT_NODELABEL(puart));
	int ret;

	ret = arm_uart_wake(puart, &stop_wake_from_puart);
	if (ret != 0) {
		printk("Failed to arm PUART Stop wake: %d\r\n", ret);
		return ret;
	}

	printk("Entering stop mode\r\n");
	printk("Press WKUP (PY07 / P1[8]) or send a byte to PUART RX (PY01)\r\n");

	ret = request_pm_state(PM_STATE_SUSPEND_TO_IDLE,
			       HPM_PM_STOP_SUBSTATE);
	disarm_uart_wake(puart);
	if (ret != 0) {
		return ret;
	}

	if (hpm_pm_wakeup_from_wkup_pin()) {
		printk("Wake source: WKUP pin (PY07)\r\n");
	} else if (stop_wake_from_puart) {
		printk("Wake source: PUART RX (PY01)\r\n");
	} else {
		printk("Wake source: unknown\r\n");
	}

	stop_wake_from_puart = false;

	return 0;
}

int enter_stop_timer_mode(void)
{
	int64_t t0;
	int64_t elapsed;

	printk("Idle Stop for %d ms (PTMR sysclock)\r\n",
	       HPM_STOP_TIMER_SLEEP_MS);
	printk("WKUP (PY07 / P1[8]) can interrupt Stop, sleep still runs\r\n");

	pm_policy_state_lock_put(PM_STATE_SUSPEND_TO_IDLE, PM_ALL_SUBSTATES);

	t0 = k_uptime_get();
	k_msleep(HPM_STOP_TIMER_SLEEP_MS);
	elapsed = k_uptime_get() - t0;

	pm_policy_state_lock_get(PM_STATE_SUSPEND_TO_IDLE, PM_ALL_SUBSTATES);

	if (hpm_pm_wakeup_from_wkup_pin()) {
		printk("Wake source: WKUP pin (PY07), slept %lld ms\r\n",
		       elapsed);
	} else {
		printk("Wake source: PTMR sysclock, slept %lld ms\r\n",
		       elapsed);
	}

	return 0;
}

void enter_standby_mode(void)
{
	printk("standby mode is not supported on HPM5151\n");
}

void enter_shutdown_mode(void)
{
	printk("Entering shutdown mode\n");
	printk("Press WKUP (PY07) or RESET to restart\n");
	z_sys_poweroff();
}
```

## src/hpm5100_lp.h
```c
/*
 * Copyright (c) 2026 HPMicro
 * SPDX-License-Identifier: Apache-2.0
 */

#ifndef HPM5100_LP_H_
#define HPM5100_LP_H_

void prepare_soc_low_power(void);
int enter_wait_mode(void);
int enter_stop_mode(void);
int enter_stop_timer_mode(void);
void enter_standby_mode(void);
void enter_shutdown_mode(void);

#endif /* HPM5100_LP_H_ */
```
