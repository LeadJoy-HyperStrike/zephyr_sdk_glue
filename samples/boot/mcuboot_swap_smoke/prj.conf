## CMakeLists.txt
```
# Copyright (c) 2026 HPMicro
# SPDX-License-Identifier: Apache-2.0

cmake_minimum_required(VERSION 3.20.0)
find_package(Zephyr REQUIRED HINTS $ENV{ZEPHYR_BASE})
project(mcuboot_swap_smoke)

target_sources(app PRIVATE src/main.c)

if(DEFINED SWAP_SMOKE_LABEL)
  zephyr_compile_definitions(SWAP_SMOKE_LABEL="${SWAP_SMOKE_LABEL}")
endif()
```

## sample.yaml
```
sample:
  name: MCUboot swap smoke
common:
  tags: mcuboot
  harness: console
  harness_config:
    type: one_line
    regex:
      - "Hello SLOT-.*"
tests:
  sample.boot.mcuboot_swap_smoke:
    platform_allow:
      - hpm5100evk
    integration_platforms:
      - hpm5100evk
```

## prj.conf
```kconfig
CONFIG_BOOTLOADER_MCUBOOT=y
CONFIG_MCUBOOT_BOOTLOADER_MODE_SWAP_SCRATCH=y
CONFIG_MCUBOOT_IMGTOOL_SIGN_VERSION="1.0.0+0"
CONFIG_MCUBOOT_GENERATE_UNSIGNED_IMAGE=n
CONFIG_MCUBOOT_SIGNATURE_KEY_FILE="bootloader/mcuboot/root-ec-p256.pem"
CONFIG_FLASH=y
CONFIG_FLASH_MAP=y
CONFIG_STREAM_FLASH=y
CONFIG_IMG_MANAGER=y
CONFIG_CONSOLE=y
CONFIG_UART_CONSOLE=y
CONFIG_LOG=n
CONFIG_HEAP_MEM_POOL_SIZE=0
CONFIG_MAIN_STACK_SIZE=2048
```

## prj_b.conf
```kconfig
CONFIG_MCUBOOT_IMGTOOL_SIGN_VERSION="1.0.1+0"
CONFIG_MCUBOOT_EXTRA_IMGTOOL_ARGS="--pad"
```

## prj_upload.conf
```kconfig
CONFIG_MCUBOOT_IMGTOOL_SIGN_VERSION="2.0.0+0"
```

## src/main.c
```c
/*
 * Copyright (c) 2026 HPMicro
 * SPDX-License-Identifier: Apache-2.0
 *
 * Distinguish images with -DEXTRA_CFLAGS="-DSWAP_SMOKE_LABEL=\\\"SLOT-B\\\""
 */

#include <zephyr/dfu/mcuboot.h>
#include <zephyr/kernel.h>
#include <zephyr/sys/printk.h>

#ifndef SWAP_SMOKE_LABEL
#define SWAP_SMOKE_LABEL "SLOT-A"
#endif

int main(void)
{
	int rc;

	printk("Hello %s! %s\n", SWAP_SMOKE_LABEL, CONFIG_BOARD_TARGET);

	if (boot_is_img_confirmed()) {
		printk("img already confirmed\n");
	} else {
		rc = boot_write_img_confirmed();
		printk("img confirm %s (%d)\n", rc ? "FAIL" : "OK", rc);
	}

	return 0;
}
```
