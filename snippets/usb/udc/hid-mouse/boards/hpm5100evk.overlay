/*
 * Copyright 2026 HPMicro
 * SPDX-License-Identifier: Apache-2.0
 */

&zephyr_udc0 {
	status = "okay";
	num-bidir-endpoints = <8>;
};

/* USER KEY PA15 uses GPIO EDGE_BOTH IRQ (HPM5151 GPIO_SOC_HAS_EDGE_BOTH). */
