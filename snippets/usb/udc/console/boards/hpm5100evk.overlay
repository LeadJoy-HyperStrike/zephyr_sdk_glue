/*
 * Copyright 2026 HPMicro
 * SPDX-License-Identifier: Apache-2.0
 */

&zephyr_udc0 {
	status = "okay";
	num-bidir-endpoints = <8>;

	cdc_acm_uart0 {
		tx-fifo-size = <256>;
		rx-fifo-size = <256>;
	};
};
