## boards/hpmicro/hpm5100evk/hpm5100evk_defconfig
```kconfig
CONFIG_CONSOLE=y
CONFIG_UART_CONSOLE=y
CONFIG_XIP=y
CONFIG_PINCTRL=y
CONFIG_GPIO=y
CONFIG_SERIAL=y
CONFIG_FLASH=y
```

## drivers/counter/Kconfig.hpmicro
```kconfig
# Copyright (c) 2026 HPMicro
# SPDX-License-Identifier: Apache-2.0

DT_COMPAT_HPM_GPTMR := hpmicro,hpm-gptmr

config COUNTER_HPM_GPTMR
	bool "HPMicro GPTMR counter driver"
	default y
	depends on COUNTER
	depends on DT_HAS_HPMICRO_HPM_GPTMR_ENABLED
	select HAS_HPMSDK_GPTMRV2
	help
	  Enable HPMicro GPTMRv2 as a Zephyr counter (reload / top IRQ).
```

## drivers/dma/Kconfig.hpmicro
```kconfig
# Copyright (c) 2024 HPMicro
# SPDX-License-Identifier: Apache-2.0
DT_COMPAT_HPM_DMA := hpmicro,hpm-dma
DT_COMPAT_HPM_DMAV2 := hpmicro,hpm-dmav2

config DMA_HPMICRO
	bool "HPMICRO DMA driver"
	default y
	depends on DT_HAS_HPMICRO_HPM_DMA_ENABLED
	select HAS_HPMSDK_DMA
	help
	  This option enables the DMA driver for HPM SoC family.

config DMAV2_HPMICRO
	bool "HPMICRO DMAV2 driver"
	default y
	depends on DT_HAS_HPMICRO_HPM_DMAV2_ENABLED
	select HAS_HPMSDK_DMAV2
	help
	  This option enables the DMAV2 driver for HPM SoC family.

config DMAV2_HPMICRO_SHORT_LOCK
	bool "Short interrupt-locked sections in the DMAV2 driver"
	depends on DMAV2_HPMICRO
	help
	  dma_config() builds the channel configuration and reads the
	  controller / DMAMUX base addresses before irq_lock(), so the locked
	  section is the DMAMUX write, the abort of a busy channel,
	  dma_setup_channel() and the bookkeeping - no flash reads (struct
	  device and its config are const) and no memcpy() while locked. The
	  half-transfer interrupt is masked (the ISR never acted on it), and
	  the ISR reads the four status registers once and handles only the
	  channels that are set instead of four reads per channel. For a
	  single-core part without nested interrupts (HS2's HPM5151), where
	  every locked section and every ISR delays every other interrupt.
	  Off, the driver builds exactly as before.
```

## drivers/flash/Kconfig.hpmicro
```kconfig
# Copyright 2025 HPMicro
# SPDX-License-Identifier: Apache-2.0

DT_COMPAT_HPMICRO_HPM_FLASH := hpmicro,xpi

config FLASH_HPMICRO
	bool "HPMicro FLASH driver"
	default y
	depends on DT_HAS_HPMICRO_XPI_ENABLED
	select HAS_HPMSDK_FLASH
	select FLASH_HAS_DRIVER_ENABLED
	select FLASH_HAS_PAGE_LAYOUT
	# XPI NOR requires sector erase before program (.erase is implemented);
	# enables STREAM_FLASH_ERASE so img_mgmt/stream_flash erase before write.
	select FLASH_HAS_EXPLICIT_ERASE
	help
	  Enable the hpmicro flash driver.

config FLASH_HPMICRO_PRE_KERNEL
	bool "Bring the XPI NOR driver up at PRE_KERNEL_1"
	depends on FLASH_HPMICRO && SOC_SERIES_HPM5100
	help
	  Register the flash device at PRE_KERNEL_1 (after the SoC init) instead
	  of POST_KERNEL, so an application init that must run before anything
	  else touches the system - the HS2 slot trial-boot accounting - can
	  program the flash first. The driver uses only irq_lock() and the ROM
	  API, no kernel objects, so nothing the kernel brings up later is
	  needed. HPM5100 only; the HPM6E00 build is unchanged.
```

## drivers/hwinfo/Kconfig.hpmicro
```kconfig
# Copyright (c) 2026 HPMicro
# SPDX-License-Identifier: Apache-2.0

config HWINFO_HPMICRO
	bool "HPMicro OTP UUID as hwinfo device ID"
	default y
	depends on HWINFO
	depends on SOC_SERIES_HPM5100
	help
	  Provide USB/device serial numbers from the SoC OTP UUID.
```

## drivers/i2c/Kconfig.hpmicro
```kconfig
# Copyright 2024 HPMicro
# SPDX-License-Identifier: Apache-2.0

DT_COMPAT_HPMICRO_HPM_I2C := hpmicro,hpm-i2c

config I2C_HPMICRO
	bool "HPMicro I2C driver"
	default y
	depends on DT_HAS_HPMICRO_HPM_I2C_ENABLED
	select HAS_HPMSDK_I2C
	help
	  Enable the hpmicro i2c driver.

config I2C_HPMICRO_VENDOR_HPM5100
	bool "HPM5100: the vendor I2C driver of the 2026-10-12 drop"
	default y
	depends on I2C_HPMICRO && SOC_SERIES_HPM5100
	help
	  The vendor driver (SDK polling helpers for single-message
	  transfers). Say n to build the driver every other SoC uses -
	  bus-time-bounded transfers, RM-ordered abort, refusal of
	  mis-sequenced message shapes, arm-before-launch interrupt enabling -
	  which HS2's touchpad recovery relies on. The I2C IP and its register
	  map are the same on HPM5100 and HPM6E00.

config I2C_HPMICRO_DMA
	bool "Move single-message controller transfers with the HDMA"
	depends on I2C_HPMICRO && !I2C_HPMICRO_VENDOR_HPM5100
	select DMA
	help
	  An instance whose devicetree node carries a dmas entry named "txrx"
	  (one HDMA channel and the controller's DMAMUX request) moves the data
	  of single-message controller transfers - 7-bit address, STOP, up to
	  I2C_HPMICRO_DMA_BUF_SIZE bytes, what i2c_read() / i2c_write() send -
	  with the HDMA through a per-instance bounce buffer. The controller
	  then raises TRANSACTION_COMPLETE only (plus the HDMA's terminal-count
	  interrupt) instead of one interrupt per 4-byte FIFO. Every other
	  shape, and every instance without "txrx", keeps the interrupt path.
	  Written for HS2's touchpad on the single-core HPM5151, where
	  interrupts do not nest.

config I2C_HPMICRO_DMA_BUF_SIZE
	int "Bounce buffer per DMA instance (bytes)"
	depends on I2C_HPMICRO_DMA
	default 32
	range 1 4096
	help
	  Longest message the DMA path takes; longer ones use the interrupt
	  path.
```

## drivers/i2s/Kconfig.hpmicro
```kconfig
# Copyright (c) 2026 HPMicro
# SPDX-License-Identifier: Apache-2.0

DT_COMPAT_HPMICRO_HPM_I2S := hpmicro,hpm-i2s

config I2S_HPMICRO
	bool "HPMicro I2S driver"
	default y
	depends on DT_HAS_HPMICRO_HPM_I2S_ENABLED
	depends on I2S
	select HAS_HPMSDK_I2S
	help
	  Enable the HPMicro I2S controller driver.

if I2S_HPMICRO
config I2S_HPMICRO_DMA
	bool "HPMicro I2S DMA support (experimental)"
	depends on DMA
	help
	  Enable DMA resource probing for HPMicro I2S.
	  Data path still defaults to polling and this option prepares
	  per-instance DMA metadata for follow-up integration.

config I2S_HPMICRO_DMA_TX_QUEUE_DEPTH
	int "HPMicro I2S DMA TX queue depth"
	depends on I2S_HPMICRO_DMA
	range 1 8
	default 2
	help
	  Number of queued TX blocks for the HPMicro I2S DMA path.
	  Lower values reduce RAM usage.

config I2S_HPMICRO_DMA_RX_QUEUE_DEPTH
	int "HPMicro I2S DMA RX queue depth"
	depends on I2S_HPMICRO_DMA
	range 1 8
	default 2
	help
	  Number of queued RX blocks for the HPMicro I2S DMA path.
	  Lower values reduce RAM usage.

config I2S_HPMICRO_DMA_TX_WATCHDOG_MS
	int "HPMicro I2S DMA TX watchdog period (ms)"
	depends on I2S_HPMICRO_DMA
	range 1 20
	default 2
	help
	  Periodic poll interval to detect TX DMA completion when callbacks
	  are delayed or missed on some platforms.

config I2S_HPMICRO_DMA_RX_WATCHDOG_MS
	int "HPMicro I2S DMA RX watchdog period (ms)"
	depends on I2S_HPMICRO_DMA
	range 1 20
	default 2
	help
	  Periodic poll interval to detect RX DMA completion when callbacks
	  are delayed or missed on some platforms.
endif
```

## drivers/spi/Kconfig.hpmicro
```kconfig
# Copyright (c) 2024 HPMicro
# SPDX-License-Identifier: Apache-2.0
DT_COMPAT_HPM_SPI := hpmicro,hpm-spi

config SPI_HPMICRO
	bool "HPMicro SPI driver"
	default y
	depends on DT_HAS_HPMICRO_HPM_SPI_ENABLED
	select HAS_HPMSDK_SPI
	select SPI
	# Slave mode is in the HPM5100 implementation only (see the comment at
	# the top of spi_hpmicro.c); forcing SPI_SLAVE elsewhere would change
	# the shared spi_context code compiled into other SoCs' images.
	select SPI_SLAVE if SOC_SERIES_HPM5100
	help
	  Enable support for hpmicro spi driver (master; slave on HPM5100).

if SPI_HPMICRO

config SPI_HPM_INTERRUPT
	bool "HPM SPI interrupt-driven transfers"
	depends on SOC_SERIES_HPM5100
	default n
	help
	  Use SPI TX/RX FIFO threshold and transfer-end interrupts
	  instead of polling spi_transfer(). Keep SCLK modest (e.g.
	  <= 1 MHz) so the ISR can keep up with the FIFO.

config SPI_HPM_SLAVE_FRAMED
	bool "HPM SPI slave cmd/addr frame (SDK-compatible)"
	depends on SPI_SLAVE
	depends on SOC_SERIES_HPM5100
	default n
	help
	  Slave uses non-data-only mode with command + address phases,
	  matching HPM SDK interrupt/DMA master samples (cmd=0x1a,
	  addr=0x10, read-dummy-write). Without this, slave is raw
	  data-only (Zephyr default).

config SPI_HPM_SPI_DMA
	bool "HPM SPI DMA Support"
	select DMA
	help
	  Enable the SPI DMA mode for SPI instances
	  that enable dma channels in their device tree node.
	  With CONFIG_SPI_ASYNC on HPM5100, DMA chunks chain in the DMA
	  callback.

endif # SPI_HPMICRO
```

## drivers/timer/Kconfig.hpmicro
```kconfig
# Copyright (c) 2026 HPMicro
# SPDX-License-Identifier: Apache-2.0

config HPM_PTMR_TIMER
	bool "HPMicro PTMR as Zephyr system timer"
	default y
	depends on SOC_SERIES_HPM5100
	depends on !RISCV_MACHINE_TIMER
	select TICKLESS_CAPABLE
	select HAS_HPMSDK_GPTMRV2
	select TIMER_HAS_64BIT_CYCLE_COUNTER
	help
	  Use the PMIC-domain PTMR (GPTMRv2) as the kernel sysclock so
	  timeouts can wake Stop. Requires &ptmr { sys-clock; } and
	  &mtimer { status = "disabled"; }. Andes mtimer stops in Stop
	  with the HPM5100 retention mask.
```

## dts/bindings/cpu/andestech,andescore-d25.yaml
```yaml
# Copyright (c) 2026 HPMicro
# SPDX-License-Identifier: Apache-2.0

description: Andes Technology RISC-V AndesCore D25 CPU

compatible: "andestech,andescore-d25"

include: riscv,cpus.yaml
```

## dts/bindings/i2s/hpmicro,hpm-i2s.yaml
```yaml
# Copyright 2026 HPMicro
# SPDX-License-Identifier: Apache-2.0

description: HPMicro I2S controller

compatible: "hpmicro,hpm-i2s"

include: [i2s-controller.yaml, pinctrl-device.yaml]

properties:
  reg:
    required: true

  interrupts:
    required: true

  clocks:
    required: true

  pinctrl-0:
    required: true

  pinctrl-names:
    required: true

  dmas:
    required: false
    description: |
      Optional TX/RX DMA specifiers.
      Expected order is TX then RX.

  dma-names:
    required: false
    description: |
      Must be "tx", "rx" when dmas is provided.
```

## dts/bindings/timer/hpmicro,hpm-gptmr.yaml
```yaml
# Copyright 2026 HPMicro
# SPDX-License-Identifier: Apache-2.0

description: HPMicro GPTMR or PMIC-domain PTMR (GPTMRv2) as Zephyr counter

compatible: "hpmicro,hpm-gptmr"

include: base.yaml

properties:
  reg:
    required: true

  interrupts:
    required: true

  clk-name:
    type: int
    required: true
    description: GPTMR/PTMR clock name (clock_gptmrN or clock_ptmr)

  channel:
    type: int
    required: true
    description: GPTMR channel used as counter (0..3)

  sys-clock:
    type: boolean
    description: |
      This instance is the Zephyr system timer. The counter driver skips it.
```
