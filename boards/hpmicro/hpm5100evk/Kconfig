## soc/hpmicro/HPM6E00/Kconfig
```kconfig
# Copyright (c) 2025 HPMicro
# SPDX-License-Identifier: Apache-2.0

config SOC_SERIES_HPM6E00
	select RISCV
	select RISCV_PRIVILEGED
	select RISCV_HAS_PLIC
	select DYNAMIC_INTERRUPTS
	help
	  Enable support for HPMicro HPM6E series SoC

config SOC_HPM6E80
	bool
	select ATOMIC_OPERATIONS_C
	select INCLUDE_RESET_VECTOR
	select RISCV_ISA_EXT_M
	select RISCV_ISA_EXT_A
    select RISCV_ISA_EXT_C
	select RISCV_ISA_EXT_ZICSR
	select RISCV_ISA_EXT_ZIFENCEI
	select CPU_HAS_DCACHE
	select CPU_HAS_ICACHE
	select RISCV_PMP if !MCUBOOT
if SOC_SERIES_HPM6E00

choice
	prompt "Base CPU ISA options"
	default HPM6E_RV32I

config HPM6E_RV32I
	bool "RISCV32 CPU ISA"
	select RISCV_ISA_RV32I

config HPM6E_RV32E
	bool "RISCV32E CPU ISA"
	select RISCV_ISA_RV32E

endchoice

choice
	prompt "FPU options"
	default HPM6E_NO_FPU

config HPM6E_NO_FPU
	bool "No FPU"

config HPM6E_SINGLE_PRECISION_FPU
	bool "Single precision FPU"
	select CPU_HAS_FPU

config HPM6E_DOUBLE_PRECISION_FPU
	bool "Double precision FPU"
	select CPU_HAS_FPU_DOUBLE_PRECISION

endchoice

config SOC_ANDES_V5_HWDSP
	bool "AndeStar V5 DSP ISA"
	select RISCV_SOC_CONTEXT_SAVE
	depends on !RISCV_GENERIC_TOOLCHAIN
	help
		This option enables the AndeStar v5 hardware DSP, in order to
		support using the DSP instructions.

config SOC_ANDES_V5_PMA
	bool "Andes V5 Physical Memory Attribute (PMA)"
	default y
	select ARCH_HAS_NOCACHE_MEMORY_SUPPORT
	select HAS_HPMSDK_PMP
	help
		This option enables the Andes V5 PMA, in order to support SW to
		configure physical memory attribute by PMA CSRs. The address
		matching of Andes V5 PMA is like RISC-V PMP NAPOT mode
		(power-of-two alignment).

config HPM_SOC_CPU_FREQ_MHZ
	int "CPU0/CPU1 core frequency (MHz)"
	default 600
	range 24 600
	help
		Core clock for CPU0 and CPU1, reached with PLL0CLK0's
		post-divider. The VCO is left exactly as the BootROM preset
		set it.

		This is a CEILING, not an exact value. The post-divider steps
		in 0.2 increments -- index n divides by (1.0 + 0.2n) -- so from
		the preset's 600 MHz VCO the reachable set is 600 / 500 /
		428.6 / 375 / 333.3 / 300 MHz. soc_init_clock() picks the first
		step at or below this number, so 400 lands on 375 and 480 lands
		on 428.6. Rounding down is what keeps the VDD_SOC bin (selected
		from this number against datasheet table 12) valid by
		construction. Asking for less than about 41 MHz saturates the
		divider and lands above the request, which is harmless only
		because every voltage bin ceiling is far above that.

		Changing this moves the two cores and nothing else. Measured on
		hpm6e00evk with `hs2clk`: of the SYSCTL clock nodes, exactly
		two select a PLL0 output, and they are CLK_TOP_CPU0 and
		CLK_TOP_CPU1. AHB0, XPI0 (the XIP flash!) and the rest of the
		peripheral tree sit on PLL1CLK0, so the ADC convert-clock
		ceiling (RM 71.2.1.1) does not move either.

		Do NOT reach the target by retuning the VCO with
		pllctlv2_init_pll_with_freq() instead. That was tried and it
		broke UART0 outright -- see the comment in soc_init_clock().
		HPM's own board support never writes MFI/MFN on this part.

		Under sysbuild this reaches the DEFAULT image only. Passing
		-DCONFIG_HPM_SOC_CPU_FREQ_MHZ=400 leaves MCUboot on 600, and
		that asymmetry is the intended arrangement, not an oversight:

		  - MCUboot is the recovery net. A clock configuration that has
		    not been proven belongs in the image you can replace over
		    USB, not in the one whose failure mode is ROM ISP.
		  - It saves nothing. MCUboot runs for well under a second on a
		    normal boot.
		  - It costs something. ECDSA-P256 verification and the
		    swap-using-scratch move over a 1536K slot both scale with
		    the core clock, so a slower bootloader lengthens DFU and
		    factory programming -- watch station timeouts.

		The hazard is not the mismatch, it is an UNNOTICED mismatch:
		this option silently applying to one image and not the other
		is exactly how a broken low-frequency path first looked like
		two unrelated bugs. To move MCUboot deliberately, pass
		-Dmcuboot_CONFIG_HPM_SOC_CPU_FREQ_MHZ=... as well, and expect
		the two images to report different core clocks until you do.

		WARNING: the core1 8 kHz engine budget is 94 us (XInput) / 96 us
		(DS4) of a 125 us period at 600 MHz. Scaling is roughly linear
		for ITCM-resident work, so 480 MHz leaves single-digit
		microseconds of margin. Re-measure the hot path before shipping
		anything below 600.

config HPM_SOC_VDD_SOC_EXTERNAL
	bool "VDD_SOC is supplied externally; the on-chip DCDC is unusable"
	default n
	help
		Set this when the board feeds VDD_SOC from an external
		regulator instead of the SoC's own DCDC, and therefore
		populates NO inductor on DCDC_LP.

		What it changes: soc_init_clock() stops calling
		pcfg_dcdc_set_voltage(). That call is NOT optional politeness
		on such a board, it is fatal. Both of its branches end in

		    while (!pcfg_dcdc_is_stable(ptr)) { NOP(); }

		(hpm_pcfg_drv.c: switch_to_dcm_mode and
		set_voltage_ccm_mode) with no timeout and no escape. With no
		inductor the converter can never reach its regulation point,
		so the loop never exits. soc_init_clock() runs inside
		irq_lock() and BEFORE the console is up, so the failure is
		mute: no banner, no USB, no shell -- indistinguishable from a
		dead part or a bad flash image. Diagnosed on PS4_V0B
		(2026-08-20) after the BootROM ISP kept enumerating fine while
		every image we built hung; ROM never touches PCFG.

		The frequency ceiling becomes a HARDWARE property once this is
		set. VDD_SOC is whatever the external regulator produces and
		software cannot move it, so CONFIG_HPM_SOC_CPU_FREQ_MHZ must be
		chosen to fit that fixed voltage against datasheet table 12,
		not the other way round. On PS4_V0B the rail is 1.2 V
		(SSP7615-12MR), which covers the <=480 MHz bin (1.175 V typ)
		but NOT the <=600 MHz bin (1.275 V typ) -- so 600 MHz on that
		board is out-of-spec silicon operation, not merely unproven.

		Leave this at n for the EVK and for any board that populates
		the DCDC inductor.

config HPM_SOC_GATE_UNUSED_CLOCKS
	bool "Leave unused peripheral clocks gated at boot"
	default n
	help
		Gates the motor-control island (QEI/QEO/RDC/MTG/VSC/CLC/PLB/
		SEI), PWM2-3 and PTPC, none of which has an enabled devicetree
		node on the boards this fork carries. EMDS is NOT in that list
		any more -- see below.

		THIS USED TO KILL THE ANALOG STICKS; root cause found and fixed
		2026-08-13. clock_emds was in the gated list, and EMDS is the
		motor island's MASTER clock gate rather than one more idle
		peripheral: UM V0.8 chapter 41 (p783) lists 互联管理器 TRGM as
		part of the 电动控制系统 and states "使用任何电动控制系统的模块前
		应首先开启EMDS 资源节点以使能电动控制系统时钟", while chapter 14's
		register table (p253) names RESOURCE[EMDS] the "motor misc
		资源寄存器" -- the resource covering island blocks with no entry
		of their own, which is exactly TRGM (there is no
		sysctl_resource_trgm). Gating EMDS therefore cut PWM0 TRGO ->
		TRGM0 -> ADC STRGI while PWM0's own resource stayed enabled and
		looked healthy. soc_init_clock() now adds clock_emds
		unconditionally, and every remaining entry owns its resource.

		IT DOES PAY, and the earlier claim that it did not is retired.
		Bench 2026-08-13 on hs2prod: 0.9 W -> 0.7 W with the list
		extended past the motor island. The old "no detectable change
		in supply current" reading was not wrong so much as scoped to
		the wrong blocks -- it only ever covered the motor peripherals,
		which are idle logic with nothing toggling, and it was taken
		with the sticks already dead so the ADC chain was stopped too.
		The blocks that moved the needle are the ordinary peripherals
		nobody had touched: 8x MCAN first, then the UART/I2C/SPI/GPTMR
		siblings.

		STILL DEFAULTS TO n only because the list is still growing and
		each extension needs its own stick check. Flip it to y once the
		current list has been through a bench run.

		Before flipping this to y: verify the analog sticks, not just
		boot and enumeration, and treat any peripheral reached by a raw
		base address as clocked-by-someone-else until proven otherwise.
		That selection rule is what failed the first time. "Nothing in
		the devicetree uses it" is NOT a safe criterion: TRGM has no
		node and no clock binding at all, the ADC driver reaches it
		through the raw trig-base address, four board configurations
		built clean, and `hs2clk` reported "0 unexpected" because a
		resource-less block is invisible to that readback.

		PWM0 is NOT covered by this option: it is the ADC TRGO source
		(trigger-pwm in the board overlays) and stays ungated always.

		Set n to restore the stock HPMicro behaviour, e.g. when bringing
		up a board that does use the motor peripherals.

endif # SOC_SERIES_HPM6E00
```
